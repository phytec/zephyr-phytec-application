## CMakeLists.txt
```
#-------------------------------------------------------------------------------
# Zephyr Example Application
#
# Copyright (c) 2021 Nordic Semiconductor ASA
# SPDX-License-Identifier: Apache-2.0

cmake_minimum_required(VERSION 3.13.1)
find_package(Zephyr REQUIRED HINTS $ENV{ZEPHYR_BASE})

project(app LANGUAGES C)

target_sources(app PRIVATE src/main.c src/heartbeat.c src/uptime_counter.c)
```

## sample.yaml
```
# This file is provided so that the application can be compiled using Twister,
# the Zephyr testing tool. In this file, multiple combinations can be specified,
# so that you can easily test all of them locally or in CI.
sample:
  description: Example application
  name: example-application
common:
  build_only: true
  integration_platforms:
    - phycore_rt1170/mimxrt1176/cm7
    - phycore_rt1170/mimxrt1176/cm4
tests:
  app.default: {}
  app.debug:
    extra_overlay_confs:
      - debug.conf
      - shell.conf
```

## prj.conf
```kconfig
# Copyright (c) 2021 Nordic Semiconductor ASA
# SPDX-License-Identifier: Apache-2.0
#
# This file contains selected Kconfig options for the application.

CONFIG_BOOT_BANNER=y
CONFIG_CAN=y
CONFIG_SPI=y
CONFIG_RTC=y
CONFIG_COUNTER=y
CONFIG_DAC=y
CONFIG_EEPROM=y
CONFIG_LED=y
```

## shell.conf
```kconfig
# Copyright (c) 2024 PHYTEC Messtechnik GmbH
# SPDX-License-Identifier: Apache-2.0
#
# This is a Kconfig fragment which can be used to enable shell-related options
# in the application. See the README for more details.

CONFIG_SHELL=y
CONFIG_GPIO_SHELL=y
CONFIG_LED_SHELL=y
CONFIG_I2C_SHELL=y
CONFIG_EEPROM_SHELL=y
CONFIG_SPI_SHELL=y
CONFIG_CAN_SHELL=y
CONFIG_RTC_SHELL=y
CONFIG_DAC_SHELL=y
```

## src/main.c
```c
/*
 * Copyright (c) 2024 PHYTEC Messtechnik GmbH
 *
 * SPDX-License-Identifier: Apache-2.0
 */

#include <stdio.h>
#include <zephyr/kernel.h>

#include "heartbeat.h"
#include "uptime_counter.h"

K_THREAD_DEFINE(heartbeat_tid, HEARTBEAT_STACKSIZE, heartbeat, NULL, NULL,
		NULL, HEARTBEAT_PRIORITY, 0, 0);

K_THREAD_DEFINE(uptime_counter_tid, UPTIME_COUNTER_STACKSIZE, uptime_counter,
		NULL, NULL, NULL, UPTIME_COUNTER_PRIORITY, 0, 0);
```

## src/heartbeat.c
```c
/*
 * Copyright (c) 2024 PHYTEC Messtechnik GmbH
 *
 * SPDX-License-Identifier: Apache-2.0
 */

#include <zephyr/kernel.h>
#include <zephyr/drivers/gpio.h>

/* The devicetree node identifier for the "led0" alias. */
#define LED0_NODE DT_ALIAS(led0)

/*
 * A build error on this line means your board is unsupported.
 * See the sample documentation for information on how to fix this.
 */
static const struct gpio_dt_spec led = GPIO_DT_SPEC_GET(LED0_NODE, gpios);

void heartbeat(void)
{
	int ret;

	if (!gpio_is_ready_dt(&led)) {
		return;
	}

	ret = gpio_pin_configure_dt(&led, GPIO_OUTPUT_ACTIVE);
	if (ret < 0) {
		return;
	}

	while (1) {
		ret = gpio_pin_set_dt(&led, 1);
		if (ret < 0) {
			return;
		}
		k_sleep(K_MSEC(150));

		ret = gpio_pin_set_dt(&led, 0);
		if (ret < 0) {
			return;
		}
		k_sleep(K_MSEC(50));

		ret = gpio_pin_set_dt(&led, 1);
		if (ret < 0) {
			return;
		}
		k_sleep(K_MSEC(150));

		ret = gpio_pin_set_dt(&led, 0);
		if (ret < 0) {
			return;
		}

		k_sleep(K_SECONDS(1));
	}
}
```

## src/heartbeat.h
```c
#ifndef HEARTBEAT_H
#define HEARTBEAT_H

/* size of stack area used by each thread */
#define HEARTBEAT_STACKSIZE	1024

/* scheduling priority used by each thread */
#define HEARTBEAT_PRIORITY	5

void heartbeat(void);

#endif /* HEARTBEAT_H */
```

## src/uptime_counter.c
```c
/*
 * Copyright (c) 2025 PHYTEC
 *
 * SPDX-License-Identifier: Apache-2.0
 */

#include <zephyr/kernel.h>
#include <zephyr/drivers/counter.h>
#include <zephyr/drivers/eeprom.h>

#define UPTIME_COUNTER_OFFSET	0
#define UPTIME_COUNTER_MAGIC	0xEE9703
#define UPTIME_COUNTER_EMPTY	0xFFFFFFFF

#define SNVS_RTC_NODE DT_NODELABEL(snvs_rtc)
#define DELAY 60

struct perisistant_values {
	uint32_t magic;
	uint32_t ticks;
};

struct counter_alarm_cfg alarm_cfg;

/*
 * Get a device structure from a devicetree node with alias eeprom-0
 */
static const struct device *get_eeprom_device(void)
{
	const struct device *const dev = DEVICE_DT_GET(DT_ALIAS(eeprom_0));

	if (!device_is_ready(dev)) {
		printk("\nError: Device \"%s\" is not ready; "
		       "check the driver initialization logs for errors.\n",
		       dev->name);
		return NULL;
	}

	printk("Found EEPROM device \"%s\"\n", dev->name);
	return dev;
}

/*
 * Get a device structure from a devicetree node with snvs_rtc
 */
static const struct device *get_snvs_rtc_device(void)
{
	const struct device *const dev = DEVICE_DT_GET(SNVS_RTC_NODE);

	if (!device_is_ready(dev)) {
		printk("\nError: Device \"%s\" is not ready; "
		       "check the driver initialization logs for errors.\n",
		       dev->name);
		return NULL;
	}

	printk("Found SNVS_RTC device \"%s\"\n", dev->name);
	return dev;
}

void uptime_counter(void)
{
	const struct device *eeprom = get_eeprom_device();
	const struct device *snvs_rtc = get_snvs_rtc_device();
	struct perisistant_values values;
	uint32_t old_ticks, now_ticks;
	uint64_t total_usec;
	int total_sec;
	int rc;

	if ((eeprom == NULL) || (snvs_rtc == NULL)) {
		return;
	}

	counter_start(snvs_rtc);

	rc = eeprom_read(eeprom, UPTIME_COUNTER_OFFSET, &values, sizeof(values));
	if (rc < 0) {
		printk("Error: Couldn't read eeprom: err: %d.\n", rc);
		return;
	}

	if (values.magic == UPTIME_COUNTER_EMPTY) {
		printk("EEPROM is empty.\n");
		values.magic = UPTIME_COUNTER_MAGIC;
		values.ticks = 0;
	} else if (values.magic != UPTIME_COUNTER_MAGIC) {
		printk("Error: EEPROM is not empty or no MAGIC header is found.\n");
		return;
	}

	old_ticks = values.ticks;

	rc = counter_get_value(snvs_rtc, &now_ticks);
	if (!counter_is_counting_up(snvs_rtc)) {
		now_ticks = counter_get_top_value(snvs_rtc) - now_ticks;
	}

	if (rc) {
		printk("Failed to read counter value (rc %d)", rc);
		return;
	}

	total_usec = counter_ticks_to_us(snvs_rtc, old_ticks + now_ticks);
	total_sec = (int)(total_usec / USEC_PER_SEC);
	printk("Device up %d hr %d min\n", total_sec/3600, (total_sec % 3600) / 60);

	while (1) {
		rc = counter_get_value(snvs_rtc, &now_ticks);
		if (!counter_is_counting_up(snvs_rtc)) {
			now_ticks = counter_get_top_value(snvs_rtc) - now_ticks;
		}

		if (rc) {
			printk("Failed to read counter value (rc %d)", rc);
			return;
		}

		values.ticks = old_ticks + now_ticks;

		rc = eeprom_write(eeprom, UPTIME_COUNTER_OFFSET, &values,
				  sizeof(values));
		if (rc < 0) {
			printk("Error: Couldn't write eeprom: rc: %d.\n", rc);
			return;
		}

		k_sleep(K_SECONDS(DELAY));
	}

	return;
}
```

## src/uptime_counter.h
```c
#ifndef UPTIME_COUNTER_H
#define UPTIME_COUNTER_H

/* size of stack area used by each thread */
#define UPTIME_COUNTER_STACKSIZE	1024

/* scheduling priority used by each thread */
#define UPTIME_COUNTER_PRIORITY		5

void uptime_counter(void);

#endif /* UPTIME_COUNTER_H */
```
