## app/common/Kconfig
```kconfig
# Copyright (c) 2025 PHYTEC
# SPDX-License-Identifier: Apache-2.0
#

menu "PHYTEC Testing Options"

config PHYTEC_SOM_TESTING
	bool "Modify application for SOM testing."
	default n

config PHYTEC_KIT_TESTING
	bool "Modify application for kit testing."
	default n

config PHYTEC_NIGHTLY_TESTING
	bool "Modify application for nightly testing."
	default n

endmenu

menu "Example Applications"

config APP_AUDIO_SELCALL
	bool "Enable the audio selcall example."
	default y
	depends on I2C
	depends on AUDIO_CODEC

config APP_BUTTON
	bool "Enable the button example."
	default y
	depends on GPIO
	depends on !PHYTEC_KIT_TESTING

config APP_CSI_CAPTURE
	bool "Enable the csi capture example."
	default n

config APP_DAC_SAWTOOTH
	bool "Enable the DAC sawtooth example."
	default y
	depends on DAC
	depends on !PHYTEC_SOM_TESTING
	depends on !PHYTEC_KIT_TESTING
	depends on !PHYTEC_NIGHTLY_TESTING

config APP_HEARTBEAT
	bool "Enable the LED heartbeat example."
	default y
	depends on GPIO
	depends on !APP_LED_ROLLOVER

config APP_LED_ROLLOVER
	bool "Enable the LED rollover example using LED subsystem."
	default n
	depends on LED
	help
		This enables an LED rollover demo that sequentially lights
		up LEDs using the LED driver subsystem instead of direct GPIO.

config APP_LVGL_RANDOM_NUMBER
	bool "Enable the LVGL random number example."
	default y
	select LVGL
	select LV_FONT_MONTSERRAT_32
	select LV_FONT_MONTSERRAT_48
	depends on DISPLAY
	depends on PHYTEC_KIT_TESTING

config APP_LVGL_TESTCARD
	bool "Enable the LVGL test card example."
	default y
	select LVGL
	depends on DISPLAY
	depends on PHYTEC_SOM_TESTING

config APP_LVGL_WIDGETS
	bool "Enable the LVGL widgets demo."
	default y
	select LVGL
	select LV_USE_DEMO_WIDGETS
	depends on DISPLAY
	depends on !PHYTEC_SOM_TESTING
	depends on !PHYTEC_KIT_TESTING
	depends on !APP_CSI_CAPTURE

config APP_UPTIME_COUNTER
	bool "Enable the uptime counter example."
	default y
	depends on EEPROM
	depends on !PHYTEC_SOM_TESTING
	depends on !PHYTEC_KIT_TESTING

config APP_USB_DEVICE
	bool "Enable the USB device mass storage example."
	default y
	depends on USB_DEVICE_STACK_NEXT

config APP_WATCHDOG
	bool "Initialize the watchdog task"
	default y
	select TASK_WDT
	depends on WATCHDOG

config APP_VIDEO_SOURCE_CROP_LEFT
	int "Crop area left value"
	default 0
	help
	   Left value of the crop area within the video source.

config APP_VIDEO_SOURCE_CROP_TOP
	int "Crop area top value"
	default 0
	help
	   Top value of the crop area within the video source.

config APP_VIDEO_SOURCE_CROP_WIDTH
	int "Crop area width value"
	default 0
	help
	   Width value of the crop area within the video source.
	   If set to 0, the crop is not applied.

config APP_VIDEO_SOURCE_CROP_HEIGHT
	int "Crop area height value"
	default 0
	help
	   Height value of the crop area within the video source.
	   If set to 0, the crop is not applied.

config APP_VIDEO_FRAME_HEIGHT
	int "Height of the video frame"
	default 0
	help
	  Height of the video frame. If set to 0, the default height is used.

config APP_VIDEO_FRAME_WIDTH
	int "Width of the video frame"
	default 0
	help
	  Width of the video frame. If set to 0, the default width is used.

config APP_VIDEO_PIXEL_FORMAT
	string "Pixel format of the video frame"
	help
	  Pixel format of the video frame. If not set, the default pixel format is used.

config APP_VIDEO_CTRL_HFLIP
	bool "Mirror the video frame horizontally"
	help
	  If set, mirror the video frame horizontally

config APP_VIDEO_CTRL_VFLIP
	bool "Mirror the video frame vertically"
	help
	  If set, mirror the video frame vertically

config APP_VIDEO_SHELL_AND_CAPTURE
	bool "Capture video even if the video shell is enabled"
	depends on VIDEO_SHELL
	default n
	help
	  If set, the video capture is enabled even if the video shell is also enabled.

config APP_VIDEO_CAM_NUM_BUFS
	int "Number of video buffers used for the camera"
	default 2
	help
	  Number of buffers in the video buffer pool used for the camera device.
	  The rest of the buffer pool will be used for other purposes such as transformation.

endmenu
```

## west.yml
```yaml
# Copyright (c) 2021 Nordic Semiconductor ASA
# SPDX-License-Identifier: Apache-2.0

manifest:
  self:
    west-commands: scripts/west-commands.yml

  remotes:
    - name: phytec
      url-base: https://github.com/phytec

  projects:
    - name: zephyr
      remote: phytec
      repo-path: zephyr-phytec
#      revision: WIP/jma@phytec.com/v4.4.0-phynext
#      revision: f7a4352fb43ff289bfa38ebb600b74e973f2008c
#      revision: 28ae7e8bccbd593ab75890fc86f1e2a8f04f60ed
#      revision: 9edd557451924c919bfeecbf4f836f475d412ac9
#      revision: d2898d3bd5d0a6bf1ab1d772fb21567e6d77775c
#      revision: 9da5c076159ce242ced0fa97fcd8088d4bc6dfcb
#      revision: 4626c0eb2a7cd94ad25ae76d4ddd25d652236e19
#      revision: 68ad2ab5edc3d23be9d2d4614dd73f19c17cffeb
#      revision: d5c2e71fa6fc479269668bc99e3ed9bb6112257d
# OK      revision: 68c9caf740277d08aae895246679c3f2cd1a76e2
# OK      revision: c2d0717c46977a0bb628bf8d134008c29f07889e
# OK      revision: b54e0ba58fde513965d077f99c9f22125fe19d68
# OK      revision: 13e69f1504b53bc72d9c15da3ebc0cb8bab80aec
# OK      revision: 5cacb801b0a86fb33ce773f05b44fc03b233b07f
# OK      revision: e90d7e94d877e6e6a235881b47f78f9939e0bda1
# OK      revision: 6834dc4e0b08cb335e8cc5792032630975f8a2ad
# OK      revision: 092a730201c74de1c9dd5f302c999a2c7a551cf1
# OK      revision: 3f88f69a8103e0957c701021a93f9c22552224fa
# OK      revision: af4b127d5ac943fef57ab2ae229bafea0908f02f
# OK      revision: 92382add7102a5d48641e95fcdfd754235b2533b
# OK      revision: a64883ef5dffc7592380a1954e009533003aa003
# OK      revision: 07f5e1488f221a31f145406b5ee53e3cbc9b5620
      revision: 8d2b1e308b229087935bccad7b5169f23c96071f
# FAIL      revision: 4d5f470290ae8918daeb7602112944c75c162ca9
# FAIL      revision: 74f1077a70adf7c6e1d2c4e456443fc7de789807
      import:
        # By using name-allowlist we can clone only the modules that are
        # strictly needed by the application.
        name-allowlist:
          - cmsis      # required by the ARM port
          - cmsis_6
          - hal_nxp    # required by NXP boards
          - lvgl
          - fatfs
```
